## configs/daisy_defconfig
```kconfig
CONFIG_LINUX_KRNL_HEADER_IMG=y
CONFIG_POSITION_INDEPENDENT=y
CONFIG_SIMPLE_FB=y
CONFIG_MSM8953=y
CONFIG_XIAOMI_DAISY=y
CONFIG_TEXT_BASE=0x81802000
CONFIG_PAYLOAD_ENTRY=0xc0000000
CONFIG_RAMDISK_ENTRY=0x43600000
```
